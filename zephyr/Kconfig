## zephyr/Kconfig
```kconfig
# Copyright (c) 2024 Michał Łyszczek
# SPDX-License-Identifier: Apache-2.0
#
config ZEPHYR_PSMQ_MODULE
	bool

config PSMQ
	bool "psmq"
	default n
	select GETOPT
	select POSIX_MQUEUE
	select POSIX_CLOCK
	select PTHREAD_IPC
	---help---
		psmq is tool set which allows IPC communication in publish/subscribe way
		created on top of posix messege queue. Full documentation is available
		at: https://psmq.bofc.pl (despite the domain, it is in english).

		Library is licensed under BSD 2-clause license. See LICENSE file in
		the downloaded code for license details.

if PSMQ

config PSMQ_MAX_CLIENTS
	int "Max number of clients"
	default 8
	---help---
		This  defines  how  many  clients  single  broker process will
		support.  Broker will return error for clients that want to
		register to it and there are already max clients connected.  psmqd
		will  allocate client array with static storage duration that is
		about 12 bytes (may vary depending on architecture) for each
		client.

config PSMQ_MSG_MAX
	int "Max size of payload"
	range 6 2147483647
	default 24
	---help---
		Defines maximum size of message that can be sent via psmq.
		Message consists of topic and payload. Topic is always
		null-terminated after which payload follows. This allows
		for some flexibility, ie if PSMQ_MSG_MAX was be 10, then
		topic could be 3 bytes long and payload 7, but also
		topic could take 9 bytes and payload only 1.

		This value has direct impact on runtime memory usage by
		psmq as this increases size of struct that is used when
		allocating memory for client. This has no impact on
		number of bytes that are sent because only actual data
		is sent over mqueue.

config PSMQ_DEBUG_LOGS
	bool "Enable debug logs"
	default n
	---help---
		Enable debug logs for all psmq related functions. This may be
		helpful finding out why messages do not reach its destination.
		Useless on production builds or when psmq works as expected.

config PSMQD_PRIORITY
	int "psmqd broker task priority"
	default 100

config PSMQD_STACKSIZE
	int "psmqd broker stack size"
	default 2048

config PSMQ_TOOLS_PUB
	bool "Enable psmq_pub shell tool"
	select SHELL
	select SHELL_GETOPT
	default n
	---help---
		Enables program which allows to publish message over psmq directly
		from command line.

config PSMQ_TOOLS_SUB
	bool "Enable psmq_sub shell tool"
	select SHELL
	select SHELL_GETOPT
	default n
	---help---
		Enables program which allows to listen to published messages on
		chosen topics. It also has capabilities to log these messages to
		a chosen file.

if PSMQ_TOOLS_SUB

config PSMQ_SUB_PRIORITY
	int "psmq_sub broker task priority"
	default 100

config PSMQ_SUB_STACKSIZE
	int "psmq_sub broker stack size"
	default 2048

endif # PSMQ_TOOLS_SUB

endif # SYSTEM_PSMQ
```
